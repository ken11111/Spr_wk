## apps/examples/security_camera/Kconfig
```kconfig
#
# For a description of the syntax of this configuration file,
# see the file kconfig-language.txt in the NuttX tools repository.
#

config EXAMPLES_SECURITY_CAMERA
	tristate "Security Camera example"
	default n
	select VIDEO
	select VIDEO_STREAM
	select VIDEO_ISX012
	select USBDEV
	select CDCACM
	---help---
		Enable the security camera example with MJPEG streaming (Phase 1.5: VGA)

if EXAMPLES_SECURITY_CAMERA

config EXAMPLES_SECURITY_CAMERA_PROGNAME
	string "Program name"
	default "security_camera"

config EXAMPLES_SECURITY_CAMERA_PRIORITY
	int "Task priority"
	default 100

config EXAMPLES_SECURITY_CAMERA_STACKSIZE
	int "Stack size"
	default 8192

config EXAMPLES_SECURITY_CAMERA_CAMERA_WIDTH
	int "Camera width (VGA)"
	default 640

config EXAMPLES_SECURITY_CAMERA_CAMERA_HEIGHT
	int "Camera height (VGA)"
	default 480

config EXAMPLES_SECURITY_CAMERA_FPS
	int "Frame rate (fps)"
	default 30

config EXAMPLES_SECURITY_CAMERA_BITRATE
	int "H.264 bitrate (bps)"
	default 2000000

config EXAMPLES_SECURITY_CAMERA_HDR_ENABLE
	bool "Enable HDR"
	default n

# Phase 7: WiFi/TCP Transport Configuration

config EXAMPLES_SECURITY_CAMERA_WIFI
	bool "Enable WiFi/TCP transport (Phase 7)"
	default n
	select WIRELESS_WAPI
	select DRIVERS_WIRELESS
	select WIRELESS_GS2200M
	select WL_GS2200M
	select NET_USRSOCK_TCP
	select NETDB_DNSCLIENT
	---help---
		Enable WiFi connectivity and TCP server for MJPEG streaming.
		Requires iS110B WiFi add-on board with GS2200M module.

if EXAMPLES_SECURITY_CAMERA_WIFI

config EXAMPLES_SECURITY_CAMERA_WIFI_SSID
	string "WiFi SSID"
	default "your_ssid_here"
	---help---
		WiFi network SSID to connect to.

config EXAMPLES_SECURITY_CAMERA_WIFI_PASSWORD
	string "WiFi Password"
	default "your_password_here"
	---help---
		WiFi network password (WPA2-PSK).

config EXAMPLES_SECURITY_CAMERA_WIFI_USE_DHCP
	bool "Use DHCP"
	default y
	---help---
		Use DHCP to obtain IP address.
		If disabled, static IP configuration will be used.

if !EXAMPLES_SECURITY_CAMERA_WIFI_USE_DHCP

config EXAMPLES_SECURITY_CAMERA_WIFI_STATIC_IP
	string "Static IP Address"
	default "192.168.1.100"

config EXAMPLES_SECURITY_CAMERA_WIFI_NETMASK
	string "Subnet Mask"
	default "255.255.255.0"

config EXAMPLES_SECURITY_CAMERA_WIFI_GATEWAY
	string "Default Gateway"
	default "192.168.1.1"

endif # !EXAMPLES_SECURITY_CAMERA_WIFI_USE_DHCP

config EXAMPLES_SECURITY_CAMERA_TCP_PORT
	int "TCP Server Port"
	default 8888
	---help---
		TCP port number for MJPEG streaming server.

config EXAMPLES_SECURITY_CAMERA_WIFI_CONNECT_TIMEOUT
	int "WiFi Connection Timeout (seconds)"
	default 15
	---help---
		Maximum time to wait for WiFi connection.

endif # EXAMPLES_SECURITY_CAMERA_WIFI

endif # EXAMPLES_SECURITY_CAMERA
```
