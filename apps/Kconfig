## apps/Kconfig.minimal_backup
```kconfig
#
# For a description of the syntax of this configuration file,
# see the file kconfig-language.txt in the NuttX tools repository.
#

menu "External Application Configuration"

source "examples/Kconfig"

endmenu
```

## apps/examples/Kconfig
```kconfig
#
# For a description of the syntax of this configuration file,
# see the file kconfig-language.txt in the NuttX tools repository.
#
# This file is modified for external apps integration
#

menu "Examples"
source "/home/ken/Spr_ws/spresense/sdk/apps/examples/abntcodi/Kconfig"
source "/home/ken/Spr_ws/spresense/sdk/apps/examples/adc/Kconfig"
source "/home/ken/Spr_ws/spresense/sdk/apps/examples/adjtime/Kconfig"
source "/home/ken/Spr_ws/spresense/sdk/apps/examples/adxl372_test/Kconfig"
source "/home/ken/Spr_ws/spresense/sdk/apps/examples/ajoystick/Kconfig"
source "/home/ken/Spr_ws/spresense/sdk/apps/examples/alarm/Kconfig"
source "/home/ken/Spr_ws/spresense/sdk/apps/examples/apa102/Kconfig"
source "/home/ken/Spr_ws/spresense/sdk/apps/examples/apds9960/Kconfig"
source "/home/ken/Spr_ws/spresense/sdk/apps/examples/audio_rttl/Kconfig"
source "/home/ken/Spr_ws/spresense/sdk/apps/examples/bastest/Kconfig"
source "/home/ken/Spr_ws/spresense/sdk/apps/examples/battery/Kconfig"
source "/home/ken/Spr_ws/spresense/sdk/apps/examples/bme680/Kconfig"
source "/home/ken/Spr_ws/spresense/sdk/apps/examples/bmi160/Kconfig"
source "$(APPDIR)/examples/bmi160_orientation/Kconfig"
source "/home/ken/Spr_ws/spresense/sdk/apps/examples/bmp180/Kconfig"
source "/home/ken/Spr_ws/spresense/sdk/apps/examples/bmp280/Kconfig"
source "/home/ken/Spr_ws/spresense/sdk/apps/examples/bridge/Kconfig"
source "/home/ken/Spr_ws/spresense/sdk/apps/examples/buttons/Kconfig"
source "/home/ken/Spr_ws/spresense/sdk/apps/examples/calib_udelay/Kconfig"
source "$(APPDIR)/examples/camera/Kconfig"
source "/home/ken/Spr_ws/spresense/sdk/apps/examples/can/Kconfig"
source "/home/ken/Spr_ws/spresense/sdk/apps/examples/capture/Kconfig"
source "/home/ken/Spr_ws/spresense/sdk/apps/examples/cbortest/Kconfig"
source "/home/ken/Spr_ws/spresense/sdk/apps/examples/cctype/Kconfig"
source "/home/ken/Spr_ws/spresense/sdk/apps/examples/charger/Kconfig"
source "/home/ken/Spr_ws/spresense/sdk/apps/examples/chat/Kconfig"
source "/home/ken/Spr_ws/spresense/sdk/apps/examples/chrono/Kconfig"
source "/home/ken/Spr_ws/spresense/sdk/apps/examples/configdata/Kconfig"
source "/home/ken/Spr_ws/spresense/sdk/apps/examples/cordic/Kconfig"
source "/home/ken/Spr_ws/spresense/sdk/apps/examples/cpuhog/Kconfig"
source "/home/ken/Spr_ws/spresense/sdk/apps/examples/cromfs/Kconfig"
source "/home/ken/Spr_ws/spresense/sdk/apps/examples/dac/Kconfig"
source "/home/ken/Spr_ws/spresense/sdk/apps/examples/dhcpd/Kconfig"
source "/home/ken/Spr_ws/spresense/sdk/apps/examples/dhtxx/Kconfig"
source "/home/ken/Spr_ws/spresense/sdk/apps/examples/discover/Kconfig"
source "/home/ken/Spr_ws/spresense/sdk/apps/examples/djoystick/Kconfig"
source "/home/ken/Spr_ws/spresense/sdk/apps/examples/dronecan/Kconfig"
source "/home/ken/Spr_ws/spresense/sdk/apps/examples/elf/Kconfig"
source "/home/ken/Spr_ws/spresense/sdk/apps/examples/embedlog/Kconfig"
source "/home/ken/Spr_ws/spresense/sdk/apps/examples/esp32_himem/Kconfig"
source "/home/ken/Spr_ws/spresense/sdk/apps/examples/etl/Kconfig"
source "/home/ken/Spr_ws/spresense/sdk/apps/examples/fb/Kconfig"
source "/home/ken/Spr_ws/spresense/sdk/apps/examples/fboverlay/Kconfig"
source "/home/ken/Spr_ws/spresense/sdk/apps/examples/flash_test/Kconfig"
source "/home/ken/Spr_ws/spresense/sdk/apps/examples/flowc/Kconfig"
source "/home/ken/Spr_ws/spresense/sdk/apps/examples/fmsynth/Kconfig"
source "/home/ken/Spr_ws/spresense/sdk/apps/examples/foc/Kconfig"
source "/home/ken/Spr_ws/spresense/sdk/apps/examples/ft80x/Kconfig"
source "/home/ken/Spr_ws/spresense/sdk/apps/examples/ftpc/Kconfig"
source "/home/ken/Spr_ws/spresense/sdk/apps/examples/ftpd/Kconfig"
source "/home/ken/Spr_ws/spresense/sdk/apps/examples/fxos8700cq_test/Kconfig"
source "/home/ken/Spr_ws/spresense/sdk/apps/examples/gpio/Kconfig"
source "/home/ken/Spr_ws/spresense/sdk/apps/examples/gps/Kconfig"
source "/home/ken/Spr_ws/spresense/sdk/apps/examples/hall/Kconfig"
source "/home/ken/Spr_ws/spresense/sdk/apps/examples/hdc1008_demo/Kconfig"
source "/home/ken/Spr_ws/spresense/sdk/apps/examples/hello/Kconfig"
source "/home/ken/Spr_ws/spresense/sdk/apps/examples/hello_nim/Kconfig"
source "/home/ken/Spr_ws/spresense/sdk/apps/examples/hello_rust/Kconfig"
source "/home/ken/Spr_ws/spresense/sdk/apps/examples/hello_zig/Kconfig"
source "/home/ken/Spr_ws/spresense/sdk/apps/examples/helloxx/Kconfig"
source "/home/ken/Spr_ws/spresense/sdk/apps/examples/hidkbd/Kconfig"
source "/home/ken/Spr_ws/spresense/sdk/apps/examples/hts221_reader/Kconfig"
source "/home/ken/Spr_ws/spresense/sdk/apps/examples/i2schar/Kconfig"
source "/home/ken/Spr_ws/spresense/sdk/apps/examples/i2sloop/Kconfig"
source "/home/ken/Spr_ws/spresense/sdk/apps/examples/igmp/Kconfig"
source "/home/ken/Spr_ws/spresense/sdk/apps/examples/ina219/Kconfig"
source "/home/ken/Spr_ws/spresense/sdk/apps/examples/ina226/Kconfig"
source "/home/ken/Spr_ws/spresense/sdk/apps/examples/ini_dumper/Kconfig"
source "/home/ken/Spr_ws/spresense/sdk/apps/examples/ipcfg/Kconfig"
source "/home/ken/Spr_ws/spresense/sdk/apps/examples/ipforward/Kconfig"
source "/home/ken/Spr_ws/spresense/sdk/apps/examples/isl29023/Kconfig"
source "/home/ken/Spr_ws/spresense/sdk/apps/examples/json/Kconfig"
source "/home/ken/Spr_ws/spresense/sdk/apps/examples/keyboard/Kconfig"
source "/home/ken/Spr_ws/spresense/sdk/apps/examples/leds/Kconfig"
source "/home/ken/Spr_ws/spresense/sdk/apps/examples/libtest/Kconfig"
source "/home/ken/Spr_ws/spresense/sdk/apps/examples/lis3dsh_reader/Kconfig"
source "/home/ken/Spr_ws/spresense/sdk/apps/examples/lp503x/Kconfig"
source "/home/ken/Spr_ws/spresense/sdk/apps/examples/lsm303_reader/Kconfig"
source "/home/ken/Spr_ws/spresense/sdk/apps/examples/lsm330spi_test/Kconfig"
source "/home/ken/Spr_ws/spresense/sdk/apps/examples/lsm6dsl_reader/Kconfig"
source "/home/ken/Spr_ws/spresense/sdk/apps/examples/ltr308/Kconfig"
source "/home/ken/Spr_ws/spresense/sdk/apps/examples/lua_module/Kconfig"
source "/home/ken/Spr_ws/spresense/sdk/apps/examples/lvgldemo/Kconfig"
source "/home/ken/Spr_ws/spresense/sdk/apps/examples/lvglterm/Kconfig"
source "/home/ken/Spr_ws/spresense/sdk/apps/examples/max31855/Kconfig"
source "/home/ken/Spr_ws/spresense/sdk/apps/examples/mcuboot/Kconfig"
source "/home/ken/Spr_ws/spresense/sdk/apps/examples/media/Kconfig"
source "/home/ken/Spr_ws/spresense/sdk/apps/examples/mld/Kconfig"
source "/home/ken/Spr_ws/spresense/sdk/apps/examples/mlx90614/Kconfig"
source "/home/ken/Spr_ws/spresense/sdk/apps/examples/mml_parser/Kconfig"
source "/home/ken/Spr_ws/spresense/sdk/apps/examples/modbus/Kconfig"
source "/home/ken/Spr_ws/spresense/sdk/apps/examples/modbusmaster/Kconfig"
source "/home/ken/Spr_ws/spresense/sdk/apps/examples/module/Kconfig"
source "/home/ken/Spr_ws/spresense/sdk/apps/examples/mount/Kconfig"
source "/home/ken/Spr_ws/spresense/sdk/apps/examples/mqttc/Kconfig"
source "/home/ken/Spr_ws/spresense/sdk/apps/examples/mtdpart/Kconfig"
source "/home/ken/Spr_ws/spresense/sdk/apps/examples/mtdrwb/Kconfig"
source "/home/ken/Spr_ws/spresense/sdk/apps/examples/netlink_route/Kconfig"
source "/home/ken/Spr_ws/spresense/sdk/apps/examples/netloop/Kconfig"
source "/home/ken/Spr_ws/spresense/sdk/apps/examples/netpkt/Kconfig"
source "/home/ken/Spr_ws/spresense/sdk/apps/examples/nettest/Kconfig"
source "/home/ken/Spr_ws/spresense/sdk/apps/examples/nimble/Kconfig"
source "/home/ken/Spr_ws/spresense/sdk/apps/examples/nng_test/Kconfig"
source "/home/ken/Spr_ws/spresense/sdk/apps/examples/noteprintf/Kconfig"
source "/home/ken/Spr_ws/spresense/sdk/apps/examples/nrc7292_fwupdate/Kconfig"
source "/home/ken/Spr_ws/spresense/sdk/apps/examples/nrf24l01_btle/Kconfig"
source "/home/ken/Spr_ws/spresense/sdk/apps/examples/nrf24l01_term/Kconfig"
source "/home/ken/Spr_ws/spresense/sdk/apps/examples/null/Kconfig"
source "/home/ken/Spr_ws/spresense/sdk/apps/examples/nunchuck/Kconfig"
source "/home/ken/Spr_ws/spresense/sdk/apps/examples/nx/Kconfig"
source "/home/ken/Spr_ws/spresense/sdk/apps/examples/nxdemo/Kconfig"
source "/home/ken/Spr_ws/spresense/sdk/apps/examples/nxflat/Kconfig"
source "/home/ken/Spr_ws/spresense/sdk/apps/examples/nxhello/Kconfig"
source "/home/ken/Spr_ws/spresense/sdk/apps/examples/nximage/Kconfig"
source "/home/ken/Spr_ws/spresense/sdk/apps/examples/nxlines/Kconfig"
source "/home/ken/Spr_ws/spresense/sdk/apps/examples/nxscope/Kconfig"
source "/home/ken/Spr_ws/spresense/sdk/apps/examples/nxterm/Kconfig"
source "/home/ken/Spr_ws/spresense/sdk/apps/examples/nxtext/Kconfig"
source "/home/ken/Spr_ws/spresense/sdk/apps/examples/obd2/Kconfig"
source "/home/ken/Spr_ws/spresense/sdk/apps/examples/oneshot/Kconfig"
source "/home/ken/Spr_ws/spresense/sdk/apps/examples/opencyphal/Kconfig"
source "/home/ken/Spr_ws/spresense/sdk/apps/examples/pca9635/Kconfig"
source "/home/ken/Spr_ws/spresense/sdk/apps/examples/pdcurses/Kconfig"
source "/home/ken/Spr_ws/spresense/sdk/apps/examples/pf_ieee802154/Kconfig"
source "/home/ken/Spr_ws/spresense/sdk/apps/examples/pipe/Kconfig"
source "/home/ken/Spr_ws/spresense/sdk/apps/examples/poll/Kconfig"
source "/home/ken/Spr_ws/spresense/sdk/apps/examples/popen/Kconfig"
source "/home/ken/Spr_ws/spresense/sdk/apps/examples/posix_spawn/Kconfig"
source "/home/ken/Spr_ws/spresense/sdk/apps/examples/powerled/Kconfig"
source "/home/ken/Spr_ws/spresense/sdk/apps/examples/powermonitor/Kconfig"
source "/home/ken/Spr_ws/spresense/sdk/apps/examples/pppd/Kconfig"
source "/home/ken/Spr_ws/spresense/sdk/apps/examples/pty_test/Kconfig"
source "/home/ken/Spr_ws/spresense/sdk/apps/examples/pwfb/Kconfig"
source "/home/ken/Spr_ws/spresense/sdk/apps/examples/pwlines/Kconfig"
source "/home/ken/Spr_ws/spresense/sdk/apps/examples/pwm/Kconfig"
source "/home/ken/Spr_ws/spresense/sdk/apps/examples/qencoder/Kconfig"
source "/home/ken/Spr_ws/spresense/sdk/apps/examples/random/Kconfig"
source "/home/ken/Spr_ws/spresense/sdk/apps/examples/relays/Kconfig"
source "/home/ken/Spr_ws/spresense/sdk/apps/examples/rfid_readuid/Kconfig"
source "/home/ken/Spr_ws/spresense/sdk/apps/examples/rgbled/Kconfig"
source "/home/ken/Spr_ws/spresense/sdk/apps/examples/romfs/Kconfig"
source "/home/ken/Spr_ws/spresense/sdk/apps/examples/rpmsgsocket/Kconfig"
source "/home/ken/Spr_ws/spresense/sdk/apps/examples/scd41/Kconfig"
source "$(APPDIR)/examples/security_camera/Kconfig"
source "/home/ken/Spr_ws/spresense/sdk/apps/examples/sendmail/Kconfig"
source "/home/ken/Spr_ws/spresense/sdk/apps/examples/serialblaster/Kconfig"
source "/home/ken/Spr_ws/spresense/sdk/apps/examples/serialrx/Kconfig"
source "/home/ken/Spr_ws/spresense/sdk/apps/examples/serloop/Kconfig"
source "/home/ken/Spr_ws/spresense/sdk/apps/examples/sht3x/Kconfig"
source "/home/ken/Spr_ws/spresense/sdk/apps/examples/slcd/Kconfig"
source "/home/ken/Spr_ws/spresense/sdk/apps/examples/smps/Kconfig"
source "/home/ken/Spr_ws/spresense/sdk/apps/examples/sotest/Kconfig"
source "/home/ken/Spr_ws/spresense/sdk/apps/examples/stat/Kconfig"
source "/home/ken/Spr_ws/spresense/sdk/apps/examples/sx127x_demo/Kconfig"
source "/home/ken/Spr_ws/spresense/sdk/apps/examples/system/Kconfig"
source "/home/ken/Spr_ws/spresense/sdk/apps/examples/tcp_ipc_client/Kconfig"
source "/home/ken/Spr_ws/spresense/sdk/apps/examples/tcp_ipc_server/Kconfig"
source "/home/ken/Spr_ws/spresense/sdk/apps/examples/tcpblaster/Kconfig"
source "/home/ken/Spr_ws/spresense/sdk/apps/examples/tcpecho/Kconfig"
source "/home/ken/Spr_ws/spresense/sdk/apps/examples/telnetd/Kconfig"
source "/home/ken/Spr_ws/spresense/sdk/apps/examples/termios/Kconfig"
source "/home/ken/Spr_ws/spresense/sdk/apps/examples/thttpd/Kconfig"
source "/home/ken/Spr_ws/spresense/sdk/apps/examples/tiff/Kconfig"
source "/home/ken/Spr_ws/spresense/sdk/apps/examples/timer/Kconfig"
source "/home/ken/Spr_ws/spresense/sdk/apps/examples/timer_gpio/Kconfig"
source "/home/ken/Spr_ws/spresense/sdk/apps/examples/touchscreen/Kconfig"
source "/home/ken/Spr_ws/spresense/sdk/apps/examples/udgram/Kconfig"
source "/home/ken/Spr_ws/spresense/sdk/apps/examples/udp/Kconfig"
source "/home/ken/Spr_ws/spresense/sdk/apps/examples/udpblaster/Kconfig"
source "/home/ken/Spr_ws/spresense/sdk/apps/examples/uid/Kconfig"
source "/home/ken/Spr_ws/spresense/sdk/apps/examples/unionfs/Kconfig"
source "/home/ken/Spr_ws/spresense/sdk/apps/examples/usbserial/Kconfig"
source "/home/ken/Spr_ws/spresense/sdk/apps/examples/userfs/Kconfig"
source "/home/ken/Spr_ws/spresense/sdk/apps/examples/usrsocktest/Kconfig"
source "/home/ken/Spr_ws/spresense/sdk/apps/examples/ustream/Kconfig"
source "/home/ken/Spr_ws/spresense/sdk/apps/examples/veml6070/Kconfig"
source "/home/ken/Spr_ws/spresense/sdk/apps/examples/watchdog/Kconfig"
source "/home/ken/Spr_ws/spresense/sdk/apps/examples/watched/Kconfig"
source "/home/ken/Spr_ws/spresense/sdk/apps/examples/watcher/Kconfig"
source "/home/ken/Spr_ws/spresense/sdk/apps/examples/webserver/Kconfig"
source "/home/ken/Spr_ws/spresense/sdk/apps/examples/wget/Kconfig"
source "/home/ken/Spr_ws/spresense/sdk/apps/examples/wgetjson/Kconfig"
source "/home/ken/Spr_ws/spresense/sdk/apps/examples/wiegand/Kconfig"
source "/home/ken/Spr_ws/spresense/sdk/apps/examples/ws2812/Kconfig"
source "/home/ken/Spr_ws/spresense/sdk/apps/examples/ws2812esp32rmt/Kconfig"
source "/home/ken/Spr_ws/spresense/sdk/apps/examples/xbc_test/Kconfig"
source "/home/ken/Spr_ws/spresense/sdk/apps/examples/xmlrpc/Kconfig"
source "/home/ken/Spr_ws/spresense/sdk/apps/examples/zerocross/Kconfig"
endmenu # Examples
```

## apps/examples/Kconfig.minimal_backup
```kconfig
#
# For a description of the syntax of this configuration file,
# see the file kconfig-language.txt in the NuttX tools repository.
#

menu "Examples"

source "security_camera/Kconfig"

endmenu
```
